## conf/layer.conf
```bitbake
# We have a conf and classes directory, add to BBPATH
BBPATH .= ":${LAYERDIR}"

# We have recipes-* directories, add to BBFILES
BBFILES += "${LAYERDIR}/recipes-*/*/*.bb \
	${LAYERDIR}/recipes-*/*/*.bbappend \
	${LAYERDIR}/recipes-*/*/*/*.bb \"

BBFILE_COLLECTIONS += "methode"
BBFILE_PATTERN_methode = "^${LAYERDIR}/"
BBFILE_PRIORITY_methode = "50"

METHODE_MIRROR="http://10.35.0.153"

LICENSE_FLAGS_WHITELIST = "oracle_java"
LICENSE_FLAGS_WHITELIST += "oracle_java_oracle-jse-jre"
#LICENSE_FLAGS_WHITELIST = "oracle_java_oracle-jse-jre"
```

## conf/machine/dcim.conf
```bitbake
#meta-methode/conf/dcim.conf
#@TYPE: Machine
#@NAME: dcim
#@DESCRIPTION: Based on machine configuration for ti am335x-evm

require conf/machine/include/ti33x.inc

PREFERRED_PROVIDER_u-boot = "u-boot-am33x"
UBOOT_SUFFIX = "bin"
UBOOT_PADDING = "2"

SERIAL_CONSOLE = "115200 ttyO0"

MACHINE_FEATURES += " eth0 touchscreen"
```
